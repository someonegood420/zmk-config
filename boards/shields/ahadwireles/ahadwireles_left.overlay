// Left half: local rows 0-4, local cols 0-6.
// No offset needed - left occupies the base of the global matrix.

#include "ahadwireles.dtsi"

&kscan {
    // Wire your 5 row diodes to pro_micro pins 4,5,6,7,8 in this order (row0..row4).
    // If you already wired different pins, edit the numbers below to match.
    row-gpios
        = <&pro_micro 4 (GPIO_ACTIVE_HIGH | GPIO_PULL_DOWN)>,
        <&pro_micro 5 (GPIO_ACTIVE_HIGH | GPIO_PULL_DOWN)>,
        <&pro_micro 6 (GPIO_ACTIVE_HIGH | GPIO_PULL_DOWN)>,
        <&pro_micro 7 (GPIO_ACTIVE_HIGH | GPIO_PULL_DOWN)>,
        <&pro_micro 8 (GPIO_ACTIVE_HIGH | GPIO_PULL_DOWN)>
        ;

    // Wire your 7 columns to pro_micro pins 9,10,11,12,13,14,15 in this order (col0..col6).
    col-gpios
        = <&pro_micro 9 GPIO_ACTIVE_HIGH>,
        <&pro_micro 10 GPIO_ACTIVE_HIGH>,
        <&pro_micro 16 GPIO_ACTIVE_HIGH>,
        <&pro_micro 17 GPIO_ACTIVE_HIGH>,
        <&pro_micro 13 GPIO_ACTIVE_HIGH>,
        <&pro_micro 14 GPIO_ACTIVE_HIGH>,
        <&pro_micro 15 GPIO_ACTIVE_HIGH>
        ;
};

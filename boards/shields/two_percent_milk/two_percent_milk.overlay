#include <dt-bindings/zmk/matrix_transform.h>

/ {
    chosen {
        zmk,physical-layout = &default_transform;
    };

    default_transform: default_transform {
        compatible = "zmk,matrix-transform";
        columns = <2>;
        rows = <1>;
        map = <&mt 0 0 &mt 0 1>;
    };
};

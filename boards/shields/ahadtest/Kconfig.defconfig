## boards/shields/ahadtest/Kconfig.defconfig
```kconfig
if SHIELD_AHADTEST_LEFT

config ZMK_KEYBOARD_NAME
    default "ahadtest"

config ZMK_SPLIT_ROLE_CENTRAL
    default y

endif # SHIELD_AHADTEST_LEFT

if SHIELD_AHADTEST_LEFT || SHIELD_AHADTEST_RIGHT

config ZMK_SPLIT
    default y

endif # SHIELD_AHADTEST_LEFT || SHIELD_AHADTEST_RIGHT
```

## boards/shields/ahadtest/Kconfig.shield
```kconfig
config SHIELD_AHADTEST_LEFT
    def_bool $(shields_list_contains,ahadtest_left)

config SHIELD_AHADTEST_RIGHT
    def_bool $(shields_list_contains,ahadtest_right)
```

## boards/shields/ahadwireles/Kconfig.defconfig
```kconfig
if SHIELD_AHADWIRELES_LEFT

config ZMK_KEYBOARD_NAME
    default "ahadwirelesstest"

config ZMK_SPLIT_ROLE_CENTRAL
    default y

endif # SHIELD_AHADWIRELES_LEFT

if SHIELD_AHADWIRELES_LEFT || SHIELD_AHADWIRELES_RIGHT

config ZMK_SPLIT
    default y

endif # SHIELD_AHADWIRELES_LEFT || SHIELD_AHADWIRELES_RIGHT
```

## boards/shields/ahadwireles/Kconfig.shield
```kconfig
config SHIELD_AHADWIRELES_LEFT
    def_bool $(shields_list_contains,ahadwireles_left)

config SHIELD_AHADWIRELES_RIGHT
    def_bool $(shields_list_contains,ahadwireles_right)
```
